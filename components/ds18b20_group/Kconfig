## components/ds18b20_group/Kconfig
```kconfig
menu "DS18B20 Group"
    config DS18B20_GROUP_MAX_SIZE
        int "Max number of devices in a group"
        default 10
        help
            Maximum supported number of devices in one group
endmenu
```

## main/Kconfig.projbuild
```kconfig
menu "Application config"
    config APP_DEVICE_NAME
        string "RainMaker device name"
        default "Fan Controller"

    config APP_DEVICE_TYPE
        string "RainMaker device type"
        default "esp.device.fan"

    config APP_CONTROL_LOOP_INTERVAL
        int "Main control loop interval in ms"
        default 1000
        help
            Interval in which temperatures are read and fan speed adjusted.
endmenu

menu "Hardware config"
    config HW_PWM_PIN
        int "Fan speed control PIN (PWM)"
        default 2

    config HW_PWM_INVERTED
        bool "Inverted PWM control"
        default 1

    config HW_RPM_PIN
        int "Fan RPM reporting PIN"
        default 32

    config HW_RPM_SAMPLES
        int "Fan RPM samples count"
        default 5
        help
            How many samples are used to smooth the RPM value.

    config HW_RPM_SAMPLING_INTERVAL
        int "Fan RPM sampling interval in ms"
        default 200

    config HW_DS18B20_PIN
        int "Sensors data PIN"
        default 15
endmenu
```

## sdkconfig.defaults
```kconfig
# Custom partition table
CONFIG_ESPTOOLPY_FLASHSIZE_4MB=y
CONFIG_PARTITION_TABLE_CUSTOM=y
CONFIG_PARTITION_TABLE_CUSTOM_FILENAME="partitions.csv"

# Enable support for power management
CONFIG_ESP_WIFI_SLP_IRAM_OPT=y
CONFIG_ESP32_DEFAULT_CPU_FREQ_80=y

# Disable insecure TLS
CONFIG_MBEDTLS_SSL_PROTO_TLS1=n
CONFIG_MBEDTLS_SSL_PROTO_TLS1_1=n

# Increase MQTT buffer - must fit whole shadow JSON document
CONFIG_MQTT_USE_CUSTOM_CONFIG=y
CONFIG_MQTT_BUFFER_SIZE=4096

# AWS Iot Shadow
CONFIG_AWS_IOT_SHADOW_SUPPORT_DELTA=n
CONFIG_AWS_IOT_SHADOW_SUPPORT_DELETE=n
```
